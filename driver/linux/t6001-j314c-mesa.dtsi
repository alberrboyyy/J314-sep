// SPDX-License-Identifier: GPL-2.0+ OR MIT
/*
 * Fragment de device tree : bus spi2 + capteur Touch ID (ADT "biosensor,mesa"), MacBook Pro 14" j314c / t6001.
 * JAMAIS DÉMARRÉ sous Linux. Compilé hors ligne avec dtc contre les sources publiques (voir README).
 *
 * Légende des commentaires :
 *   VÉRIFIÉ = confirmé par l'essai MESA-HELLO depuis m1n1 (docs/verification_status.md SPI-3, 2 essais) ;
 *   LU      = lu dans l'ADT de la machine (traces/20261108-162919_adt) ou sur le Mac en lecture seule ;
 *   CALQUÉ  = copié de la déclaration publique de spi1/spi3 (t600x-die0.dtsi), non vérifié pour spi2 ;
 *   INCONNU = non établi.
 *
 * À inclure après t6001-j314c.dts (voir t6001-j314c-mesa-test.dts). Les deux nœuds sont « disabled » ici :
 * c'est le fichier de test qui les active.
 */

#include <dt-bindings/gpio/gpio.h>

/* Le nœud spi2 n'existe pas dans le DT public (seuls spi1 et spi3). */
&{/soc} {
	spi2: spi@39b108000 {
		compatible = "apple,t6000-spi", "apple,spi";	/* CALQUÉ (spi1/spi3) ; MESA-HELLO a piloté spi2 avec la
								 * séquence de registres de spi-apple.c : même bloc matériel */
		reg = <0x3 0x9b108000 0x0 0x4000>;		/* LU : ADT spi2, entre spi1 (…104000) et spi3 (…10c000) ;
								 * VÉRIFIÉ : c'est l'adresse utilisée par MESA-HELLO */
		interrupt-parent = <&aic>;
		interrupts = <AIC_IRQ 0 1108 IRQ_TYPE_LEVEL_HIGH>;	/* numéro LU (ADT = 1108, entre 1107 et 1109) ;
									 * forme et type CALQUÉS ; jamais vue se déclencher */
		#address-cells = <1>;
		#size-cells = <0>;
		clocks = <&clkref>;		/* CALQUÉ sur spi3 (24 MHz). Indice : macOS annonce « CCLK 24 MHz » pour spi2
						 * comme pour spi3 (trace C1). Lien exact avec l'ADT (clock-ids 378) : INCONNU */
		power-domains = <&ps_spi2>;	/* LU : pmgr SPI2 = registre 0x28e580200 = ps_spi2 du DT public ; allumé sous m1n1.
						 * Sous Linux ce domaine sera coupé/rallumé par le noyau : jamais essayé */
		/*
		 * Pas de pinctrl : VÉRIFIÉ que le capteur répond avec les broches telles qu'iBoot les laisse.
		 * (Broches supposées : gpio0 48, 49, 50, fonction 1 ; hypothèse, docs/sensor_hw.md.)
		 * Pas de cs-gpios : ce bus n'a pas de broche chip-select (LU : ADT function-spi_cs0 = null).
		 */
		status = "disabled";

		mesa: biosensor@0 {
			compatible = "biosensor,mesa";	/* LU : nom de l'ADT ; ce n'est pas un nom officiel Linux */
			reg = <0>;			/* imposé par Linux ; aucune broche derrière (voir README, chip-select) */
			/*
			 * VÉRIFIÉ : registre diviseur = 3 (macOS et MESA-HELLO). spi-apple.c calcule
			 * diviseur = arrondi_sup(horloge / fréquence) : avec 24 MHz, 8000000 donne 3 (comme vérifié),
			 * 6000000 donnerait 4 (plus lent, jamais essayé). L'ADT dit aussi 8000000 (LU).
			 * Fréquence réelle sur le fil : 8 MHz (24/3) ou 6 MHz (24/(3+1)) : INCONNU. Ne vaut que si clocks = 24 MHz.
			 */
			spi-max-frequency = <8000000>;
			spi-cpha;			/* VÉRIFIÉ : CPHA = 1, CPOL = 0 */
			pwr-gpios = <&pinctrl_ap 196 GPIO_ACTIVE_HIGH>;	/* VÉRIFIÉ : gpio0 196, 0 = éteint, 1 = allumé */

			/*
			 * Volontairement absent :
			 *  - interruption du capteur (LU : gpio0 195, drapeau 3) : la déclarer ferait régler la broche 195 par
			 *    Linux dès le démarrage, ce que MESA-HELLO n'a pas fait. Type front/niveau : INCONNU.
			 *    interrupts-extended = <&pinctrl_ap 195 IRQ_TYPE_EDGE_BOTH>;
			 *  - délais de l'ADT (7 et 10, unité inconnue) : le module utilise les délais vérifiés (40 et 60 ms) ;
			 *  - reset, alimentation 1,8 V, DMA : non utilisés par MESA-HELLO.
			 */
			status = "disabled";
		};
	};
};
